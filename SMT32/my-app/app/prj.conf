## CMakeLists.txt
```
#-------------------------------------------------------------------------------
# Zephyr Example Application
#
# Copyright (c) 2021 Nordic Semiconductor ASA
# SPDX-License-Identifier: Apache-2.0

cmake_minimum_required(VERSION 3.13.1)
find_package(Zephyr REQUIRED HINTS $ENV{ZEPHYR_BASE})

project(app LANGUAGES C)

target_sources(app PRIVATE
  src/main.c
  src/dac_hw.c
  src/adc_hw.c
  src/fft_uart.c
  src/led.c
  src/button.c
  src/shell_cmds.c
)

# Incluir o diretório raiz do projeto para dac_sen.h e dac_sen_alto.h
target_include_directories(app PRIVATE ${CMAKE_CURRENT_SOURCE_DIR}/..)
```

## Kconfig
```
# Copyright (c) 2021 Nordic Semiconductor ASA
# SPDX-License-Identifier: Apache-2.0
#
# This file is the application Kconfig entry point. All application Kconfig
# options can be defined here or included via other application Kconfig files.
# You can browse these options using the west targets menuconfig (terminal) or
# guiconfig (GUI).

menu "Zephyr"
source "Kconfig.zephyr"
endmenu

config APP_WITH_STM32_HAL
	default y
	bool
	select USE_STM32_HAL_GPIO
	select USE_STM32_HAL_ADC
	select USE_STM32_HAL_ADC_EX
	select USE_STM32_HAL_DAC
	select USE_STM32_HAL_DAC_EX
	select USE_STM32_HAL_DMA
	select USE_STM32_HAL_DMA_EX
	select USE_STM32_HAL_CORTEX
	select USE_STM32_HAL_TIM
	select USE_STM32_HAL_TIM_EX
```

## prj.conf
```kconfig
# Copyright (c) 2021 Nordic Semiconductor ASA
# SPDX-License-Identifier: Apache-2.0

# ---------- Shell (console via ST-LINK = lpuart1, configurado no board DTS) ----------
CONFIG_SHELL=y
CONFIG_SHELL_BACKEND_SERIAL=y

# ---------- Diagnóstico de threads (não intrusivo) ----------
CONFIG_THREAD_MONITOR=y
CONFIG_THREAD_RUNTIME_STATS=y
CONFIG_THREAD_RUNTIME_STATS_USE_TIMING_FUNCTIONS=y
CONFIG_THREAD_NAME=y
CONFIG_THREAD_STACK_INFO=y

# ---------- GPIO (LED + botão) ----------
CONFIG_GPIO=y

# ---------- UART assíncrono (ESP32 via USART3) ----------
CONFIG_SERIAL=y
CONFIG_UART_ASYNC_API=y

# ---------- FFT via CMSIS-DSP ----------
CONFIG_CMSIS_DSP=y
CONFIG_CMSIS_DSP_TRANSFORM=y
CONFIG_CMSIS_DSP_COMPLEXMATH=y
CONFIG_CMSIS_DSP_STATISTICS=y
CONFIG_FPU=y

# ---------- Heap do kernel (para sys_heap_runtime_stats_get) ----------
CONFIG_HEAP_MEM_POOL_SIZE=1024
CONFIG_SYS_HEAP_RUNTIME_STATS=y

# ---------- Timing para runtime stats ----------
CONFIG_TIMING_FUNCTIONS=y

# Inicializa stacks com padrão para k_thread_stack_space_get()
CONFIG_INIT_STACKS=y
```

## boards/nucleo_g474re.overlay
```dts
/*
 * SPDX-License-Identifier: Apache-2.0
 *
 * NUCLEO-G474RE overlay para o analisador de espectro em tempo real.
 *
 * Pinout:
 *   PA4  - DAC1_OUT1 / ADC2_IN17 (loopback analógico, já no board DTS)
 *   PB10 - USART3_TX  → ESP32 RX (GND comum obrigatório entre as placas)
 *   PA5  - LED LD2    (já definido como led0 no board DTS)
 *   PC13 - Botão B1   (já definido como sw0 no board DTS)
 *
 * DAC1_CH1, ADC2 e TIM6 são configurados via STM32Cube HAL em dac_hw.c/
 * adc_hw.c, não precisam de nó no devicetree.
 */

/* USART3 → ESP32, 115200 8N1, só TX (o ESP32 nunca responde) */
&usart3 {
	pinctrl-0 = <&usart3_tx_pb10>;
	pinctrl-names = "default";
	current-speed = <115200>;
	status = "okay";
	/* DMA1 CH4 (idx 3) req 0x1D = USART3_TX */
	dmas = <&dmamux1 3 0x1D (STM32_DMA_MEMORY_TO_PERIPH | STM32_DMA_MEM_INC)>;
	dma-names = "tx";
};

/* Habilitar DMA1 e DMAMUX1 para o driver Zephyr do USART3 */
&dma1 {
	status = "okay";
};

&dmamux1 {
	status = "okay";
};

/* DAC1 desabilitado: dac_hw.c inicializa tudo via HAL (PA4, TIM6, sem DMA). */
&dac1 {
	status = "disabled";
};
```

## src/main.c
```c
#include <zephyr/kernel.h>
#include <zephyr/sys/printk.h>

extern void dac_hw_init(void);
extern void adc_hw_init(void);
extern void led_hw_init(void);

int main(void)
{
	dac_hw_init();
	adc_hw_init();
	led_hw_init();
	return 0;
}
```

## src/adc_hw.c
```c
/*
 * ADC2_IN17 (PA4) + DMA2_Channel1 — captura de 512 amostras via TIM6_TRGO,

 */

#include <zephyr/kernel.h>
#include <zephyr/irq.h>
#include <zephyr/sys/printk.h>

#include <stm32g4xx_hal.h>

#define ADC_BUF_LEN 512U

K_SEM_DEFINE(adc_ready_sem, 0, 1);

uint16_t adc_buf[ADC_BUF_LEN];

ADC_HandleTypeDef hadc2;
DMA_HandleTypeDef hdma_adc2;

/* ---------- ISR DMA2_Channel1 ---------- */
static void dma2_channel1_adc_isr(void)
{
	HAL_DMA_IRQHandler(&hdma_adc2);
}

/* ---------- Callback HAL: buffer de captura completo ---------- */
void HAL_ADC_ConvCpltCallback(ADC_HandleTypeDef *hadc)
{
	ARG_UNUSED(hadc);
	k_sem_give(&adc_ready_sem);
}

/* ---------- DMA2_Channel1 para ADC2 ---------- */
static void adc_dma_init(void)
{
	__HAL_RCC_DMAMUX1_CLK_ENABLE();
	__HAL_RCC_DMA2_CLK_ENABLE();

	hdma_adc2.Instance                = DMA2_Channel1;
	hdma_adc2.Init.Request             = DMA_REQUEST_ADC2;
	hdma_adc2.Init.Direction           = DMA_PERIPH_TO_MEMORY;
	hdma_adc2.Init.PeriphInc           = DMA_PINC_DISABLE;
	hdma_adc2.Init.MemInc              = DMA_MINC_ENABLE;
	hdma_adc2.Init.PeriphDataAlignment = DMA_PDATAALIGN_HALFWORD;
	hdma_adc2.Init.MemDataAlignment    = DMA_MDATAALIGN_HALFWORD;
	hdma_adc2.Init.Mode                = DMA_CIRCULAR;
	hdma_adc2.Init.Priority            = DMA_PRIORITY_VERY_HIGH;
	HAL_DMA_Init(&hdma_adc2);

	__HAL_LINKDMA(&hadc2, DMA_Handle, hdma_adc2);

	IRQ_CONNECT(DMA2_Channel1_IRQn, 5, dma2_channel1_adc_isr, NULL, 0);
	irq_enable(DMA2_Channel1_IRQn);
}

/* ---------- ADC2 ---------- */
static void adc2_init(void)
{
	__HAL_RCC_ADC12_CLK_ENABLE();

	hadc2.Instance                   = ADC2;
	hadc2.Init.ClockPrescaler        = ADC_CLOCK_SYNC_PCLK_DIV4;
	hadc2.Init.Resolution            = ADC_RESOLUTION_12B;
	hadc2.Init.DataAlign             = ADC_DATAALIGN_RIGHT;
	hadc2.Init.GainCompensation      = 0;
	hadc2.Init.ScanConvMode          = ADC_SCAN_DISABLE;
	hadc2.Init.EOCSelection          = ADC_EOC_SINGLE_CONV;
	hadc2.Init.LowPowerAutoWait      = DISABLE;
	hadc2.Init.ContinuousConvMode    = DISABLE;
	hadc2.Init.NbrOfConversion       = 1;
	hadc2.Init.DiscontinuousConvMode = DISABLE;
	hadc2.Init.ExternalTrigConv      = ADC_EXTERNALTRIG_T6_TRGO;
	hadc2.Init.ExternalTrigConvEdge  = ADC_EXTERNALTRIGCONVEDGE_RISING;
	hadc2.Init.DMAContinuousRequests = ENABLE;
	hadc2.Init.Overrun               = ADC_OVR_DATA_OVERWRITTEN;
	hadc2.Init.OversamplingMode      = DISABLE;
	HAL_ADC_Init(&hadc2);

	ADC_ChannelConfTypeDef sConfig = {0};

	sConfig.Channel      = ADC_CHANNEL_17;
	sConfig.Rank         = ADC_REGULAR_RANK_1;
	sConfig.SamplingTime = ADC_SAMPLETIME_12CYCLES_5;
	sConfig.SingleDiff   = ADC_SINGLE_ENDED;
	sConfig.OffsetNumber = ADC_OFFSET_NONE;
	sConfig.Offset       = 0;
	HAL_ADC_ConfigChannel(&hadc2, &sConfig);

	printk("ADC2 iniciado via HAL (PA4, trigger TIM6_TRGO, DMA2_CH1)\n");
}

/* ---------- API pública ---------- */

void adc_hw_init(void)
{
	adc_dma_init();
	adc2_init();

	HAL_ADC_Start_DMA(&hadc2, (uint32_t *)adc_buf, ADC_BUF_LEN);
}
```

## src/adc_hw.h
```c
/* ADC2_IN17 (PA4, loopback do DAC) + DMA2_CH1 via STM32 LL.
 * Captura 512 amostras por requisição. Usa TIM6_TRGO como trigger.
 *
 * DMA2 (não gerenciado pelo driver Zephyr) permite IRQ_CONNECT sem
 * conflito com o driver de DMA1 do Zephyr. ISR dá k_sem_give(adc_ready_sem).
 */
#pragma once
#include <stdint.h>

#define ADC_BUF_LEN 512U

/* Buffer de amostras (uint16_t, 12 bits, range 0–4095). */
extern uint16_t adc_buf[ADC_BUF_LEN];

void adc_hw_init(void);

/* Inicia uma nova captura de ADC_BUF_LEN amostras.
 * Quando concluir, ISR DMA2_CH1 faz k_sem_give(&adc_ready_sem). */
void adc_hw_start_capture(void);
```

## src/button.c
```c
/*
 * button_task — detecta o pressionamento do botão B1 e alterna a senoide do
 *DAC entre bin 100 (~8613 Hz) e bin 200 (~17227 Hz).
 *
 * Debounce via k_timer retriggerable: cada borda reinicia um one-shot de
 * 100 ms; só quando o timer expira de fato (100 ms sem nova borda) é que o
 * pino é relido e, se ainda ativo, o evento é sinalizado pra thread.
 */

#include <zephyr/kernel.h>
#include <zephyr/drivers/gpio.h>
#include <zephyr/sys/printk.h>

extern void dac_hw_toggle_sen(void);
extern atomic_t sen_sel; /* definido em dac_hw.c; só lido aqui p/ log */

#define BTN_NODE DT_ALIAS(sw0)
static const struct gpio_dt_spec btn = GPIO_DT_SPEC_GET(BTN_NODE, gpios);
static struct gpio_callback btn_gpio_cb;

K_SEM_DEFINE(btn_sem, 0, 1);

#define DEBOUNCE_MS 100
#define STACK_SIZE  512
#define PRIORITY    5

static void btn_debounce_expiry(struct k_timer *timer);
K_TIMER_DEFINE(btn_debounce_timer, btn_debounce_expiry, NULL);

/* ISR: chamada pelo subsistema GPIO na borda ativa do botão */
static void btn_isr(const struct device *dev, struct gpio_callback *cb,
		    uint32_t pins)
{
	ARG_UNUSED(dev);
	ARG_UNUSED(cb);
	ARG_UNUSED(pins);
	/* (Re)inicia o one-shot; repiques dentro da janela só adiam a checagem */
	k_timer_start(&btn_debounce_timer, K_MSEC(DEBOUNCE_MS), K_NO_WAIT);
}

/* Timer expirou sem nova borda por DEBOUNCE_MS: pressionamento estabilizado */
static void btn_debounce_expiry(struct k_timer *timer)
{
	ARG_UNUSED(timer);
	if (gpio_pin_get_dt(&btn)) {
		k_sem_give(&btn_sem);
	}
}

static void btn_entry(void *p1, void *p2, void *p3)
{
	ARG_UNUSED(p1); ARG_UNUSED(p2); ARG_UNUSED(p3);

	if (!device_is_ready(btn.port)) {
		printk("Error: GPIO do botão não pronto\n");
		return;
	}

	gpio_pin_configure_dt(&btn, GPIO_INPUT);
	gpio_pin_interrupt_configure_dt(&btn, GPIO_INT_EDGE_TO_ACTIVE);
	gpio_init_callback(&btn_gpio_cb, btn_isr, BIT(btn.pin));
	gpio_add_callback(btn.port, &btn_gpio_cb);

	while (1) {
		/* Bloqueia sem consumir CPU até o próximo clique debounced */
		k_sem_take(&btn_sem, K_FOREVER);

		dac_hw_toggle_sen();
		printk("Botão pressionado -> seno %s\n",
		       (atomic_get(&sen_sel) == 0) ? "bin 100" : "bin 200");
	}
}

K_THREAD_DEFINE(button_task_id, STACK_SIZE, btn_entry, NULL, NULL, NULL,
		 PRIORITY, 0, 0);
```

## src/dac_hw.c
```c
/*
 * DAC1 CH1 + TIM7 + DMA2_Channel2 — saída senoide contínua via DMA circular,
 * disparada por trigger de hardware (TRGO) dedicado, independente do TIM6
 * que dispara o ADC (adc_hw.c). Ver CLAUDE.md para o histórico da errata
 * ES0430 e por que os dois periféricos não podem compartilhar o mesmo TRGO.
 */

#include <zephyr/kernel.h>
#include <zephyr/irq.h>
#include <zephyr/sys/printk.h>

#include <stm32g4xx_hal.h>

#include "dac_sen.h"
#include "dac_sen_alto.h"

atomic_t sen_sel = ATOMIC_INIT(0);

TIM_HandleTypeDef htim6;
TIM_HandleTypeDef htim7;
DAC_HandleTypeDef hdac1;
DMA_HandleTypeDef hdma_dac1_ch1;

/* ---------- ISR DMA2_Channel2 (DAC1 CH1) — dispatcher HAL ---------- */
static void dma2_channel2_dac_isr(void)
{
	HAL_DMA_IRQHandler(&hdma_dac1_ch1);
}

/* ---------- PA4 modo analógico ---------- */
static void pa4_analog_init(void)
{
	__HAL_RCC_GPIOA_CLK_ENABLE();

	GPIO_InitTypeDef gpio = {0};

	gpio.Pin  = GPIO_PIN_4;
	gpio.Mode = GPIO_MODE_ANALOG;
	gpio.Pull = GPIO_NOPULL;
	HAL_GPIO_Init(GPIOA, &gpio);
}

/* ---------- TIM6 — TRGO consumido só pelo ADC2 (adc_hw.c) ---------- */
static void tim6_init(void)
{
	__HAL_RCC_TIM6_CLK_ENABLE();

	htim6.Instance               = TIM6;
	htim6.Init.Prescaler         = 0;
	htim6.Init.CounterMode       = TIM_COUNTERMODE_UP;
	htim6.Init.Period            = 3854;
	htim6.Init.ClockDivision     = TIM_CLOCKDIVISION_DIV1;
	htim6.Init.AutoReloadPreload = TIM_AUTORELOAD_PRELOAD_ENABLE;
	HAL_TIM_Base_Init(&htim6);

	TIM_MasterConfigTypeDef sMasterConfig = {0};

	sMasterConfig.MasterOutputTrigger = TIM_TRGO_UPDATE;
	sMasterConfig.MasterSlaveMode     = TIM_MASTERSLAVEMODE_ENABLE;
	HAL_TIMEx_MasterConfigSynchronization(&htim6, &sMasterConfig);
}

/* ---------- TIM7 — TRGO dedicado ao DAC1 CH1, mesma taxa do TIM6 ---------- */
static void tim7_init(void)
{
	__HAL_RCC_TIM7_CLK_ENABLE();

	htim7.Instance               = TIM7;
	htim7.Init.Prescaler         = 0;
	htim7.Init.CounterMode       = TIM_COUNTERMODE_UP;
	htim7.Init.Period            = 3854;
	htim7.Init.ClockDivision     = TIM_CLOCKDIVISION_DIV1;
	htim7.Init.AutoReloadPreload = TIM_AUTORELOAD_PRELOAD_ENABLE;
	HAL_TIM_Base_Init(&htim7);

	TIM_MasterConfigTypeDef sMasterConfig = {0};

	sMasterConfig.MasterOutputTrigger = TIM_TRGO_UPDATE;
	sMasterConfig.MasterSlaveMode     = TIM_MASTERSLAVEMODE_ENABLE;
	HAL_TIMEx_MasterConfigSynchronization(&htim7, &sMasterConfig);
}

/* ---------- DMA2_Channel2 para DAC1 CH1 ---------- */
static void dac_dma_init(void)
{
	__HAL_RCC_DMAMUX1_CLK_ENABLE();
	__HAL_RCC_DMA2_CLK_ENABLE();

	hdma_dac1_ch1.Instance                = DMA2_Channel2;
	hdma_dac1_ch1.Init.Request             = DMA_REQUEST_DAC1_CHANNEL1;
	hdma_dac1_ch1.Init.Direction           = DMA_MEMORY_TO_PERIPH;
	hdma_dac1_ch1.Init.PeriphInc           = DMA_PINC_DISABLE;
	hdma_dac1_ch1.Init.MemInc              = DMA_MINC_ENABLE;
	hdma_dac1_ch1.Init.PeriphDataAlignment = DMA_PDATAALIGN_WORD;
	hdma_dac1_ch1.Init.MemDataAlignment    = DMA_MDATAALIGN_HALFWORD;
	hdma_dac1_ch1.Init.Mode                = DMA_CIRCULAR;
	hdma_dac1_ch1.Init.Priority            = DMA_PRIORITY_VERY_HIGH;
	HAL_DMA_Init(&hdma_dac1_ch1);

	__HAL_LINKDMA(&hdac1, DMA_Handle1, hdma_dac1_ch1);

	IRQ_CONNECT(DMA2_Channel2_IRQn, 5, dma2_channel2_dac_isr, NULL, 0);
	irq_enable(DMA2_Channel2_IRQn);
}

/* ---------- DAC1 CH1 ---------- */
static void dac1_ch1_init(void)
{
	__HAL_RCC_DAC1_CLK_ENABLE();

	hdac1.Instance = DAC1;
	HAL_DAC_Init(&hdac1);

	DAC_ChannelConfTypeDef sConfig = {0};

	sConfig.DAC_HighFrequency          = DAC_HIGH_FREQUENCY_INTERFACE_MODE_AUTOMATIC;
	sConfig.DAC_DMADoubleDataMode       = DISABLE;
	sConfig.DAC_SignedFormat            = DISABLE;
	sConfig.DAC_SampleAndHold           = DAC_SAMPLEANDHOLD_DISABLE;
	sConfig.DAC_Trigger                 = DAC_TRIGGER_T7_TRGO;
	sConfig.DAC_Trigger2                = DAC_TRIGGER_NONE;
	sConfig.DAC_OutputBuffer            = DAC_OUTPUTBUFFER_ENABLE;
	sConfig.DAC_ConnectOnChipPeripheral = DAC_CHIPCONNECT_EXTERNAL;
	sConfig.DAC_UserTrimming            = DAC_TRIMMING_FACTORY;
	HAL_DAC_ConfigChannel(&hdac1, &sConfig, DAC_CHANNEL_1);
}

/* ---------- API pública ---------- */

void dac_hw_init(void)
{
	pa4_analog_init();
	tim6_init();
	tim7_init();
	dac_dma_init();
	dac1_ch1_init();

	/* Ordem crítica: arma o DMA do DAC ANTES de iniciar o TIM7, para que o
	 * primeiro TRGO já encontre um pedido de DMA pronto para ser atendido
	 * (é essa a lição do padrão validado em gustavowd/ex_freertos_g474
	 * para evitar a errata ES0430 — ver nota no CLAUDE.md).
	 */
	HAL_TIM_Base_Start(&htim6);
	HAL_DAC_Start_DMA(&hdac1, DAC_CHANNEL_1, (uint32_t *)dac_sen, DAC_SEN_LEN, DAC_ALIGN_12B_R);
	HAL_TIM_Base_Start(&htim7);

	printk("DAC hw iniciado via HAL + DMA2_Channel2 (TIM7 TRGO dedicado, sen bin %s)\n",
	       (atomic_get(&sen_sel) == 0) ? "100" : "200");
}

void dac_hw_toggle_sen(void)
{
	atomic_t new_sel = atomic_get(&sen_sel) ^ 1;

	atomic_set(&sen_sel, new_sel);

	const uint16_t *sen = (new_sel == 0) ? dac_sen : dac_sen_alto;

	HAL_DAC_Stop_DMA(&hdac1, DAC_CHANNEL_1);
	HAL_DAC_Start_DMA(&hdac1, DAC_CHANNEL_1, (uint32_t *)sen, DAC_SEN_LEN, DAC_ALIGN_12B_R);

	printk("sen trocado -> bin %s (~%u Hz)\n",
	       (new_sel == 0) ? "100" : "200",
	       (new_sel == 0) ? 8613U : 17226U);
}
```

## src/dac_hw.h
```c
/* DAC1_CH1 + TIM6 via STM32 LL — saída senoide contínua via ISR (sem DMA). */
#pragma once

void dac_hw_init(void);

/* Troca a LUT usada pela ISR do TIM6 (chamado pela button_task).
 * Sincroniza através de atomic_t lut_sel em sync.h. */
void dac_hw_toggle_lut(void);
```

## src/fft_uart.c
```c
/*
 * fft_uart_task: FFT 512 pts sobre ADC, envia frame 518 bytes via USART3
 */

#include <zephyr/kernel.h>
#include <zephyr/device.h>
#include <zephyr/drivers/uart.h>
#include <zephyr/sys/printk.h>

#include <arm_math.h>

#include "dac_sen.h"

extern struct k_sem adc_ready_sem;
#define ADC_BUF_LEN 512U
extern uint16_t adc_buf[ADC_BUF_LEN];

#define FFT_BINS    256
#define FRAME_TOTAL (2 + 4 + FFT_BINS * 2)   /* 518 bytes */

typedef struct __attribute__((packed)) {
	uint8_t  sync[2];
	uint32_t sample_rate;
	uint16_t data[FFT_BINS];
} fft_frame_t;

K_SEM_DEFINE(uart_tx_sem, 0, 1);

static const struct device *uart_dev = DEVICE_DT_GET(DT_NODELABEL(usart3));

static float32_t fft_in[ADC_BUF_LEN];
static float32_t fft_out[ADC_BUF_LEN];
static float32_t mag[FFT_BINS];
static fft_frame_t tx_frame;

/* ---------- Callback UART ---------- */
static void uart_cb(const struct device *dev, struct uart_event *evt, void *ud)
{
	ARG_UNUSED(ud);
	ARG_UNUSED(dev);

	if (evt->type == UART_TX_DONE) {
		k_sem_give(&uart_tx_sem);
	}
}

/* ---------- Thread ---------- */
#define STACK_SIZE 4096
#define PRIORITY   7

static void fft_uart_entry(void *p1, void *p2, void *p3)
{
	ARG_UNUSED(p1); ARG_UNUSED(p2); ARG_UNUSED(p3);

	if (!device_is_ready(uart_dev)) {
		printk("Error: USART3 nao pronto\n");
		return;
	}

	uart_callback_set(uart_dev, uart_cb, NULL);

	arm_rfft_fast_instance_f32 fft;

	arm_rfft_fast_init_f32(&fft, ADC_BUF_LEN);

	tx_frame.sync[0]     = 0xAA;
	tx_frame.sync[1]     = 0x55;
	tx_frame.sample_rate = DAC_FS_HZ;

	while (1) {
		k_sem_take(&adc_ready_sem, K_FOREVER);

		for (int i = 0; i < (int)ADC_BUF_LEN; i++) {
			fft_in[i] = (float32_t)adc_buf[i] - 2048.0f;
		}

		arm_rfft_fast_f32(&fft, fft_in, fft_out, 0);

		mag[0] = fabsf(fft_out[0]);
		arm_cmplx_mag_f32(&fft_out[2], &mag[1], FFT_BINS - 2);
		mag[FFT_BINS - 1] = fabsf(fft_out[1]);

		float32_t peak;
		uint32_t  peak_idx;

		arm_max_f32(mag, FFT_BINS, &peak, &peak_idx);
		if (peak < 1.0f) {
			peak = 1.0f;
		}
		for (int i = 0; i < FFT_BINS; i++) {
			tx_frame.data[i] = (uint16_t)(mag[i] / peak * 65535.0f);
		}

		int ret = uart_tx(uart_dev, (const uint8_t *)&tx_frame,
				  FRAME_TOTAL, SYS_FOREVER_US);
		if (ret == 0) {
			k_sem_take(&uart_tx_sem, K_FOREVER);
		} else {
			printk("Warning: uart_tx falhou: %d\n", ret);
		}

		k_msleep(100);
	}
}

K_THREAD_DEFINE(fft_uart_task_id, STACK_SIZE, fft_uart_entry, NULL, NULL, NULL,
		 PRIORITY, 0, 0);
```

## src/fft_uart.h
```c
/* Thread que calcula a FFT sobre o buffer do ADC e envia frames via USART3. */
#pragma once

void fft_uart_init(void);
```

## src/led.c
```c
/*
 * led_hw_init — pisca o LED LD2 a cada 500 ms via k_timer periódico.
 * Sem thread dedicada: como o professor faz no ex_freertos_g474 (timer de
 * software puro), não vale a pena gastar uma thread inteira só pra isso.
 */

#include <zephyr/kernel.h>
#include <zephyr/drivers/gpio.h>
#include <zephyr/sys/printk.h>

#define LED_NODE DT_ALIAS(led0)
static const struct gpio_dt_spec led = GPIO_DT_SPEC_GET(LED_NODE, gpios);

#define BLINK_MS 500U

static void led_expiry(struct k_timer *timer)
{
	ARG_UNUSED(timer);
	gpio_pin_toggle_dt(&led);
}

K_TIMER_DEFINE(led_blink_timer, led_expiry, NULL);

void led_hw_init(void)
{
	if (!device_is_ready(led.port)) {
		printk("Error: GPIO do LED não pronto\n");
		return;
	}
	gpio_pin_configure_dt(&led, GPIO_OUTPUT_INACTIVE);

	k_timer_start(&led_blink_timer, K_MSEC(BLINK_MS), K_MSEC(BLINK_MS));
}
```

## src/shell_cmds.c
```c
/*
 * sysinfo tasks    — lista threads (nome, prio, stack)
 * sysinfo rt       — tempo de CPU por thread 
 * sysinfo heap     — estatísticas do heap do kernel
 *
 */

#include <zephyr/kernel.h>
#include <zephyr/shell/shell.h>
#include <zephyr/sys/mem_stats.h>
#include <stdio.h>

/* ---------- sysinfo tasks ---------- */

static void print_thread_cb(const struct k_thread *t, void *user_data)
{
	const struct shell *sh = (const struct shell *)user_data;
	const char *name = k_thread_name_get((k_tid_t)t);
	size_t unused = 0;

	k_thread_stack_space_get(t, &unused);
	size_t used = t->stack_info.size - unused;

	shell_print(sh, "  %-20s  %4d   %4zu / %4zu",
		    (name && name[0]) ? name : "(sem nome)",
		    t->base.prio,
		    used,
		    t->stack_info.size);
}

static int cmd_tasks(const struct shell *sh, size_t argc, char **argv)
{
	ARG_UNUSED(argc); ARG_UNUSED(argv);
	shell_print(sh, "  NOME                  PRIO   STACK_USADO / TOTAL");
	shell_print(sh, "  -------------------------------------------------------");
	k_thread_foreach_unlocked(print_thread_cb, (void *)sh);
	return 0;
}

/* ---------- sysinfo heap ---------- */

static int cmd_heap(const struct shell *sh, size_t argc, char **argv)
{
	ARG_UNUSED(argc); ARG_UNUSED(argv);

	extern struct sys_heap _system_heap;
	struct sys_memory_stats stats;

	if (sys_heap_runtime_stats_get(&_system_heap, &stats) == 0) {
		shell_print(sh, "  Heap do kernel:");
		shell_print(sh, "    livre      : %zu B", stats.free_bytes);
		shell_print(sh, "    usado      : %zu B", stats.allocated_bytes);
		shell_print(sh, "    pico uso   : %zu B", stats.max_allocated_bytes);
	} else {
		shell_print(sh, "  Estatísticas de heap indisponíveis.");
	}
	return 0;
}

/* ---------- sysinfo rt (runtime stats) ---------- */

static void print_rt_cb(const struct k_thread *t, void *user_data)
{
	uint64_t sys_total = (uint64_t)(uintptr_t)user_data;
	struct k_thread_runtime_stats stats;

	if (k_thread_runtime_stats_get((k_tid_t)t, &stats) != 0) {
		return;
	}

	const char *name = k_thread_name_get((k_tid_t)t);
	uint32_t pct = (sys_total > 0)
		? (uint32_t)((stats.execution_cycles * 100ULL) / sys_total)
		: 0U;

	printk("  %-20s  %12llu ciclos  %3u %%\n",
	       (name && name[0]) ? name : "(sem nome)",
	       (unsigned long long)stats.execution_cycles,
	       pct);
}

static int cmd_rt(const struct shell *sh, size_t argc, char **argv)
{
	ARG_UNUSED(argc); ARG_UNUSED(argv);

	struct k_thread_runtime_stats all;
	k_thread_runtime_stats_all_get(&all);
	uint64_t sys_total = all.execution_cycles;

	shell_print(sh, "  NOME                  CICLOS CPU          CPU %%");
	shell_print(sh, "  -------------------------------------------------------");
	k_thread_foreach_unlocked(print_rt_cb, (void *)(uintptr_t)sys_total);
	return 0;
}

/* ---------- Registro de subcomandos ---------- */

SHELL_STATIC_SUBCMD_SET_CREATE(sysinfo_cmds,
	SHELL_CMD(tasks, NULL, "Lista threads com uso de stack", cmd_tasks),
	SHELL_CMD(heap,  NULL, "Estatísticas do heap do kernel", cmd_heap),
	SHELL_CMD(rt,    NULL, "Tempo de CPU por thread",        cmd_rt),
	SHELL_SUBCMD_SET_END
);

SHELL_CMD_REGISTER(sysinfo, &sysinfo_cmds,
		   "Informações do sistema (não intrusivo)", NULL);
```

## src/sync.h
```c
/* Objetos de sincronismo compartilhados entre tarefas. */
#pragma once
#include <zephyr/kernel.h>

/* ADC DMA2_CH1 "transfer complete" ISR → fft_uart_task */
extern struct k_sem adc_ready_sem;

/* UART TX_DONE callback → fft_uart_task */
extern struct k_sem uart_tx_sem;

/* GPIO EXTI botão → button_task */
extern struct k_sem btn_sem;

/* Seleção de LUT: 0 = dac_lut (bin 100), 1 = dac_lut_high (bin 200) */
extern atomic_t lut_sel;
```
